## config/west.yml
```yaml
manifest:
  defaults:
    revision: v0.3
  remotes:
    - name: zmkfirmware
      url-base: https://github.com/zmkfirmware
    - name: zmk-locales_base
      url-base: https://github.com/joelspadin
    - name: janpfischer
      url-base: https://github.com/janpfischer
  #  - name: englmaxi
  #    url-base: https://github.com/englmaxi

  # Additional modules containing boards/shields/custom code can be listed here as well
  # See https://docs.zephyrproject.org/3.2.0/develop/west/manifest.html#projects
  projects:
    - name: zmk
      remote: zmkfirmware
      import: app/west.yml
    - name: zmk-locales
      remote: zmk-locales_base
      revision: main
    #  - name: zmk-dongle-display
    #    remote: englmaxi
    #    revision: v0.3
    # - name: zmk-dongle-screen
    #   remote: janpfischer
    #   revision: main

    - name: prospector-zmk-module # <--- and these
      remote: carrefinho # <---
      revision: main
  self:
    path: config
```
